#include "font.h"

// Русский шрифт 5x8 (А-Я, без ЁЙ) + пробел
const uint8_t font_5x8[][5] = {
    // Цифры 0-9 (индексы 0-9)
    {0x3E, 0x51, 0x49, 0x45, 0x3E}, // 0
    {0x00, 0x42, 0x7F, 0x40, 0x00}, // 1
    {0x42, 0x61, 0x51, 0x49, 0x46}, // 2
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    {0x06, 0x49, 0x49, 0x29, 0x1E}, // 9
    // Буквы
    {0x7C, 0x12, 0x11, 0x12, 0x7C}, // А (1040)
    {0x7F, 0x49, 0x49, 0x49, 0x31}, // Б (1041)
    {0x7F, 0x49, 0x49, 0x49, 0x36}, // В (1042)
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    {0x00, 0x03, 0x01, 0x5D, 0x03},  // Вопросительный знак (46)
};

// Вертикальный шрифт 8x5, повернутый из font_5x8
const uint8_t font_8x5[][8] = {
    { 0x00, 0x0E, 0x11, 0x13, 0x15, 0x19, 0x11, 0x0E },
    { 0x00, 0x0E, 0x04, 0x04, 0x04, 0x04, 0x06, 0x04 },
    { 0x00, 0x1F, 0x02, 0x04, 0x08, 0x10, 0x11, 0x0E },
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    { 0x00, 0x08, 0x00, 0x08, 0x08, 0x08, 0x12, 0x1E }
};

// Функция отрисовки символа (вертикальный или горизонтальный)
void draw_char(spi_device_handle_t spi, uint16_t x, uint16_t y, uint16_t unicode, uint16_t color, uint8_t vertical) {
    uint8_t index;
    if (unicode >= u'0' && unicode <= u'9') {
        index = unicode - u'0';
    } else if (unicode >= u'А' && unicode <= u'Я') {
        index = 10 + (unicode - u'А');
    } else if (unicode == u'.') {
        index = 43;
    } else if (unicode == u',') {
        index = 44;
    } else if (unicode == u'!') {
        index = 45;
    } else if (unicode == u'?') {
        index = 46;
    } else {
        index = 42; // Пробел
    }

    if (vertical) {
        for (uint8_t col = 0; col < 8; col++) {
            uint8_t pixels = font_8x5[index][col];
        
            for (uint8_t bit = 0; bit < 7; bit++) {
                if (pixels & (1 << bit)) {
                    fill_rect(spi, x + col, y + bit, 1, 1, color);
                }
            }
        }
    } else {
        for (uint8_t col = 0; col < 5; col++) {
            uint8_t pixels = font_5x8[index][col];
            for (uint8_t row = 0; row < 8; row++) {
                if (pixels & (1 << row)) {
                    fill_rect(spi, x + col, y + row, 1, 1, color);
                }
            }
        }
    }
}

// Функция отрисовки строки
void draw_text(spi_device_handle_t spi, uint16_t x, uint16_t y, const uint16_t *unicode_text, uint16_t color, uint8_t vertical) {
    uint8_t xv = (vertical) ? 0 : 6;
    uint8_t yv = (vertical) ? 6 : 0;
    while (*unicode_text) {
        draw_char(spi, x, y, *unicode_text, color, vertical);
        y += yv;
        x += xv;
        unicode_text++;
    }
}

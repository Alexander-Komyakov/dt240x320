#include "font.h"


// Простой шрифт 5x8 (цифры и некоторые буквы)
const uint8_t font_5x8[][5] = {
    {0x3E, 0x51, 0x49, 0x45, 0x3E}, // 0
    {0x00, 0x42, 0x7F, 0x40, 0x00}, // 1
    {0x42, 0x61, 0x51, 0x49, 0x46}, // 2
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    {0x00, 0x07, 0x00, 0x07, 0x00}, // :
};

// Функция вывода символа
void draw_char(spi_device_handle_t spi, uint16_t x, uint16_t y, char c, uint16_t color) {
    uint8_t index = 0;

    if (c >= '0' && c <= '9') {
        index = c - '0';
    } else if (c >= 'A' && c <= 'Z') {
        index = c - 'A' + 10;
    } else if (c >= 'a' && c <= 'z') {
        index = c - 'a' + 10;
    } else if (c == ' ') {
        index = 36;
    } else if (c == '!') {
        index = 37;
    } else if (c == ':') {
        index = 38;
    } else {
        return;
    }

    for (uint8_t col = 0; col < 5; col++) {
        uint8_t pixels = font_5x8[index][col];
        for (uint8_t row = 0; row < 8; row++) {
            if (pixels & (1 << row)) {
                fill_rect(spi, x + col, y + row, 1, 1, color);
            }
        }
    }
}

// Функция вывода строки
void draw_text(spi_device_handle_t spi, uint16_t x, uint16_t y, const char *text, uint16_t color) {
    while (*text) {
        draw_char(spi, x, y, *text, color);
        x += 6;
        text++;
    }
}
